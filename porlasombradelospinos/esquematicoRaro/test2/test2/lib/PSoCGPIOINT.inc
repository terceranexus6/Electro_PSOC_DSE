;  Generated by PSoC Designer 5.4.2946
;
; AnalogColumn_InputMUX_0 address and mask equates
AnalogColumn_InputMUX_0_Data_ADDR:	equ	0h
AnalogColumn_InputMUX_0_DriveMode_0_ADDR:	equ	100h
AnalogColumn_InputMUX_0_DriveMode_1_ADDR:	equ	101h
AnalogColumn_InputMUX_0_DriveMode_2_ADDR:	equ	3h
AnalogColumn_InputMUX_0_GlobalSelect_ADDR:	equ	2h
AnalogColumn_InputMUX_0_IntCtrl_0_ADDR:	equ	102h
AnalogColumn_InputMUX_0_IntCtrl_1_ADDR:	equ	103h
AnalogColumn_InputMUX_0_IntEn_ADDR:	equ	1h
AnalogColumn_InputMUX_0_MASK:	equ	2h
; AnalogColumn_InputMUX_0_Data access macros
;   GetAnalogColumn_InputMUX_0_Data macro, return in a
macro GetAnalogColumn_InputMUX_0_Data
	mov		a,[Port_0_Data_SHADE]
	and		a, 2h
endm
;   SetAnalogColumn_InputMUX_0_Data macro
macro SetAnalogColumn_InputMUX_0_Data
	or		[Port_0_Data_SHADE], 2h
	mov		a, [Port_0_Data_SHADE]
	mov		reg[AnalogColumn_InputMUX_0_Data_ADDR], a
endm
;   ClearAnalogColumn_InputMUX_0_Data macro
macro ClearAnalogColumn_InputMUX_0_Data
	and		[Port_0_Data_SHADE], ~2h
	mov		a, [Port_0_Data_SHADE]
	mov		reg[AnalogColumn_InputMUX_0_Data_ADDR], a
endm

; AnalogOutBuf_0 address and mask equates
AnalogOutBuf_0_Data_ADDR:	equ	0h
AnalogOutBuf_0_DriveMode_0_ADDR:	equ	100h
AnalogOutBuf_0_DriveMode_1_ADDR:	equ	101h
AnalogOutBuf_0_DriveMode_2_ADDR:	equ	3h
AnalogOutBuf_0_GlobalSelect_ADDR:	equ	2h
AnalogOutBuf_0_IntCtrl_0_ADDR:	equ	102h
AnalogOutBuf_0_IntCtrl_1_ADDR:	equ	103h
AnalogOutBuf_0_IntEn_ADDR:	equ	1h
AnalogOutBuf_0_MASK:	equ	8h
; AnalogOutBuf_0_Data access macros
;   GetAnalogOutBuf_0_Data macro, return in a
macro GetAnalogOutBuf_0_Data
	mov		a,[Port_0_Data_SHADE]
	and		a, 8h
endm
;   SetAnalogOutBuf_0_Data macro
macro SetAnalogOutBuf_0_Data
	or		[Port_0_Data_SHADE], 8h
	mov		a, [Port_0_Data_SHADE]
	mov		reg[AnalogOutBuf_0_Data_ADDR], a
endm
;   ClearAnalogOutBuf_0_Data macro
macro ClearAnalogOutBuf_0_Data
	and		[Port_0_Data_SHADE], ~8h
	mov		a, [Port_0_Data_SHADE]
	mov		reg[AnalogOutBuf_0_Data_ADDR], a
endm

; LEDPin address and mask equates
LEDPin_Data_ADDR:	equ	0h
LEDPin_DriveMode_0_ADDR:	equ	100h
LEDPin_DriveMode_1_ADDR:	equ	101h
LEDPin_DriveMode_2_ADDR:	equ	3h
LEDPin_GlobalSelect_ADDR:	equ	2h
LEDPin_IntCtrl_0_ADDR:	equ	102h
LEDPin_IntCtrl_1_ADDR:	equ	103h
LEDPin_IntEn_ADDR:	equ	1h
LEDPin_MASK:	equ	80h
; LEDPin_Data access macros
;   GetLEDPin_Data macro, return in a
macro GetLEDPin_Data
	mov		a,[Port_0_Data_SHADE]
	and		a, 80h
endm
;   SetLEDPin_Data macro
macro SetLEDPin_Data
	or		[Port_0_Data_SHADE], 80h
	mov		a, [Port_0_Data_SHADE]
	mov		reg[LEDPin_Data_ADDR], a
endm
;   ClearLEDPin_Data macro
macro ClearLEDPin_Data
	and		[Port_0_Data_SHADE], ~80h
	mov		a, [Port_0_Data_SHADE]
	mov		reg[LEDPin_Data_ADDR], a
endm

