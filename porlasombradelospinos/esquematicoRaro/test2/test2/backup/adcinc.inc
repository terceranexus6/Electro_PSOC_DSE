;;*****************************************************************************
;;*****************************************************************************
;;  FILENAME: ADCINC.inc
;;  Version: 1.20, Updated on 2014/7/14 at 8:3:53
;;  Generated by PSoC Designer 5.4.2946
;;
;;  DESCRIPTION: Assembler declarations for the 8-bit ADCINC A/D Converter
;;               User Module with a 2nd-order modulator.
;;-----------------------------------------------------------------------------
;;  Copyright (c) Cypress Semiconductor 2014. All Rights Reserved.
;;*****************************************************************************
;;*****************************************************************************

include "m8c.inc"
include "memory.inc"

;--------------------------------------------------
; Constants for ADCINC API's.
;--------------------------------------------------

ADCINC_OFF:                     equ 00h
ADCINC_LOWPOWER:                equ 01h
ADCINC_MEDPOWER:                equ 02h
ADCINC_HIGHPOWER:               equ 03h

ADCINC_bNUMBITS:               equ 0eh
ADCINC_SIGNED_DATA:            equ 0
ADCINC_9_OR_MORE_BITS:         equ ((0eh - 1)& 08h)
ADCINC_8_OR_MORE_BITS:         equ ((0eh )& 08h)


;--------------------------------------------------
; Register Address Constants for ADCINC
;--------------------------------------------------
ADCINC_ISR_MASK:                       equ 02h
ADCINC_ISR_REG:                        equ   0e1h
ADCINC_CLR_REG:                        equ (((ADCINC_ISR_REG & 038h)/8)^0dfh)


ADCINC_PWMdr0:                 equ 24h     ; Period reg
ADCINC_PWMdr1:                 equ 25h     ; Down count reg
ADCINC_PWMdr2:                 equ 26h     ; Compare reg
ADCINC_PWMcr0:                 equ 27h     ; Control reg
ADCINC_PWMfn:                  equ 24h     ; Function reg
ADCINC_PWMsl:                  equ 25h     ; Input  select reg
ADCINC_PWMos:                  equ 26h     ; Output select reg

ADCINC_AtoD1cr0:               equ 0x80    ; SC Block 1 Control Reg 0
ADCINC_AtoD1cr1:               equ 0x81    ; SC Block 1 Control Reg 1
ADCINC_AtoD1cr2:               equ 0x82    ; SC Block 1 Control Reg 2
ADCINC_AtoD1cr3:               equ 0x83    ; SC Block 1 Control Reg 3
ADCINC_AtoD2cr0:               equ 0x90    ; SC Block 2 Control Reg 0
ADCINC_AtoD2cr1:               equ 0x91    ; SC Block 2 Control Reg 1
ADCINC_AtoD2cr2:               equ 0x92    ; SC Block 2 Control Reg 2
ADCINC_AtoD2cr3:               equ 0x93    ; SC Block 2 Control Reg 3

HighByte: equ 0
LowByte:  equ 1

macro ADCINC_fIsDataAvailable_M
   RAM_SETPAGE_CUR >ADCINC_fStatus
   mov A,[ADCINC_fStatus]
endm


macro ADCINC_iGetData_M
   RAM_SETPAGE_CUR >ADCINC_iResult
   mov X,[(ADCINC_iResult + HighByte)]
   mov A,[(ADCINC_iResult + LowByte)]
endm


macro ADCINC_wGetData_M
   ADCINC_iGetData_M
endm


macro ADCINC_cGetData_M
   RAM_SETPAGE_CUR >ADCINC_iResult
   mov A,[(ADCINC_iResult + LowByte)]
endm


macro ADCINC_bGetData_M
   ADCINC_cGetData_M
endm


macro ADCINC_fClearFlag_M
   RAM_SETPAGE_CUR >ADCINC_fStatus
   mov A,[ADCINC_fStatus]
   mov [ADCINC_fStatus],00h
endm


macro ADCINC_iClearFlagGetData_M
   RAM_SETPAGE_CUR >ADCINC_fStatus
  .repeat:
      mov [ADCINC_fStatus],00h
      mov X,[(ADCINC_iResult + HighByte)]
      mov A,[(ADCINC_iResult + LowByte)]
      cmp [ADCINC_fStatus],00h
  .until: jnz .repeat
endm


macro ADCINC_wClearFlagGetData_M
   ADCINC_iClearFlagGetData_M
endm


macro ADCINC_cClearFlagGetData_M
   RAM_SETPAGE_CUR >ADCINC_fStatus
   mov [ADCINC_fStatus],00h
   mov A,[(ADCINC_iResult + LowByte)]
endm


macro ADCINC_bClearFlagGetData_M
   ADCINC_cClearFlagGetData_M
endm


macro ADCINC_ENABLE_INTEGRATOR_M  
   and reg[ADCINC_AtoD1cr3],~10h
   and reg[ADCINC_AtoD1cr2],~20h
   and reg[ADCINC_AtoD2cr3],~10h
   and reg[ADCINC_AtoD2cr2],~20h
endm


macro ADCINC_RESET_INTEGRATOR_M  
   or  reg[ADCINC_AtoD1cr2],20h
   or  reg[ADCINC_AtoD1cr3],10h
   or  reg[ADCINC_AtoD2cr2],20h
   or  reg[ADCINC_AtoD2cr3],10h
endm


macro ADCINC_STARTADC_M  
   ;Enable PWM interrupt 
   mov reg[ADCINC_CLR_REG],~(ADCINC_ISR_MASK)
   or  reg[ADCINC_ISR_REG], (ADCINC_ISR_MASK)
endm


macro ADCINC_STOPADC_M
   ;Disable PWM interrupt  
   and reg[ADCINC_ISR_REG],~(ADCINC_ISR_MASK)
endm


macro ADCINC_WritePulseWidth_M
    mov reg[ADCINC_PWMdr2],A
endm

; end of file ADCINC.inc
